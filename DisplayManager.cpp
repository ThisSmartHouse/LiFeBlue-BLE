/*
  +----------------------------------------------------------------------+
  | LiFeBlue Bluetooth Interface                                         |
  +----------------------------------------------------------------------+
  | Copyright (c) 2017-2019 Internet Technology Solutions, LLC,          |
  +----------------------------------------------------------------------+
  | Licensed under the Apache License, Version 2.0 (the "License");      |
  | you may not use this file except in compliance with the License. You |
  | may obtain a copy of the License at:                                 |
  |                                                                      |
  | http://www.apache.org/licenses/LICENSE-2.0                           |
  |                                                                      |
  | Unless required by applicable law or agreed to in writing, software  |
  | distributed under the License is distributed on an "AS IS" BASIS,    |
  | WITHOUT WARRANTIES OR CONDITIONS OF ANY KIND, either express or      |
  | implied. See the License for the specific language governing         |
  | permissions and limitations under the License.                       |
  +----------------------------------------------------------------------+
  | Authors: John Coggeshall <john@thissmarthouse.com>                   |
  +----------------------------------------------------------------------+
*/

#include "DisplayManager.h"

const unsigned char logo [] PROGMEM = {
  0xff, 0xff, 0xff, 0xff, 0xff, 0xff, 0xff, 0xff, 0xdf, 0xff, 0xff, 0xff, 0xff, 0xff, 0xff, 0xff, 
  0xff, 0xff, 0xff, 0xff, 0xff, 0xff, 0xff, 0xff, 0x27, 0xff, 0xff, 0xff, 0xff, 0xff, 0xff, 0xff, 
  0xff, 0xff, 0xff, 0xff, 0xff, 0xff, 0xff, 0xfc, 0x89, 0xff, 0xff, 0xff, 0xff, 0xff, 0xff, 0xff, 
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  0xff, 0x07, 0x8f, 0xcc, 0x78, 0xc7, 0x1f, 0x1f, 0xf8, 0xe3, 0xff, 0xff, 0xf0, 0x7c, 0x1e, 0x03
};


DisplayManager *DisplayManager::m_instance = NULL;

DisplayManager::DisplayManager()
{
#if defined(WIFI_LoRa_32) || defined(WIFI_LoRa_32_V2)
  Wire.begin(4, 15);
#endif

  display = new Adafruit_SSD1306(SCREEN_WIDTH, SCREEN_HEIGHT, &Wire, OLED_RESET_PIN);
  batteryManager = BatteryManager::instance();
}

DisplayManager *DisplayManager::instance()
{
  if(!m_instance) {
    m_instance = new DisplayManager();
  }

  return m_instance;
}



void DisplayManager::setup()
{
  if(!display->begin(SSD1306_SWITCHCAPVCC, OLED_ADDRESS)) {
    Serial.println("SSD1306 Failed to initailize");
    for(;;);
  }
  
  display->clearDisplay();

  display->drawBitmap(0, 3, logo, 128, 58, 1);

  display->setTextSize(1);
  display->setTextColor(WHITE);
  display->setCursor(0, 0);
  display->cp437(true);

  display->display();
  delay(5000);
  display->clearDisplay();
  display->display();
}

void DisplayManager::scanningScreen(uint8_t percent)
{
  display->clearDisplay();

  display->setCursor(0, 20);
  display->print("Searching....");
  drawProgress(0, 30, 120, 20, percent);
  
  display->display();
}

void DisplayManager::wifiConnectScreen(uint8_t percent)
{
  display->clearDisplay();
  display->setCursor(0,20);
  display->print("Connecting WiFi..");
  drawProgress(0, 30, 120, 20, percent);
  display->display();
}

void DisplayManager::statusScreen()
{
  batteryInfo_t *batteryInfo;
  uint8_t totalCells;
    
  if(batteryManager->getTotalBatteries() == 0) {
    display->clearDisplay();
    display->setCursor(0,0);
    display->print("No Batteries Found");
    display->display();
    return;
  }

  if(currentBattery >= batteryManager->getTotalBatteries()) {
    currentBattery = 0;
  }

  batteryInfo = batteryManager->getBattery(currentBattery);
  
  display->clearDisplay();
  display->setCursor(0, 0);
  display->println("LiFeBlue Monitor");
  display->print(batteryInfo->device->getAddress().toString().c_str());
  
  display->setCursor(0,20);
  display->printf("V: %.2fV\nC: %.2fA\nSoC: %u%%\nT: %.1fC", 
                  (float)batteryInfo->voltage / 1000,
                  (float)batteryInfo->current / 1000,
                  batteryInfo->soc,
                  (float)batteryInfo->temp / 10);

  totalCells = batteryManager->getTotalCells();

  if(totalCells > 0) {
    display->setCursor(65, 20);

    for(int i = 0; (i < 5) && (i < totalCells); i++) {
      display->printf("%d: %umV\n", i+1, batteryInfo->cells[i]);
      display->setCursor(65, 20+ ((i+1) * 8));
    }
    
  }

  if(WiFi.status() == WL_CONNECTED) {
    display->setCursor(0, 56);
    display->println(WiFi.localIP().toString().c_str());
    display->setCursor(110, 0);
    display->print(2 * (WiFi.RSSI() + 100));
    display->print("%");
  }
  
  display->display();

  currentBattery++;
}

void DisplayManager::drawProgress(uint8_t x, uint8_t y, uint8_t width, uint8_t height, uint8_t percent)
{
  float bar;
  
  percent = (percent > 100) ? 100 : percent;
  percent = (percent < 0) ? 0 : percent;

  bar = ((float)(width - 1) / 100) * percent;

  display->drawRect(x, y, width, height, WHITE);
  display->fillRect(x + 2, y + 2, bar, height - 4, WHITE);
}
